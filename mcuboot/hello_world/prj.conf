## prj.conf
```kconfig
# Basic Hello World Configuration
# No WiFi or networking needed for simple printf

# Logging (minimal level)
CONFIG_LOG=n
```

## src/main.c
```c
/*
 * Copyright (c) 2012-2014 Wind River Systems, Inc.
 *
 * SPDX-License-Identifier: Apache-2.0
 */

#include <stdio.h>

int main(void)
{
	printf("Hello World! %s\n", "ESP32");

	return 0;
}
```
